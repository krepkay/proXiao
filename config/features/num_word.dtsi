/ {
    behaviors {
        num_word: num_word {
            #binding-cells = <0>;
            compatible = "zmk,behavior-num-word";
            continue-list = <BSPC DEL DOT COMMA PLUS MINUS STAR FSLH EQUAL>;
            ignore-numbers;
        };
    };
};
