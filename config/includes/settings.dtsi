// Make sure this file is included before all other files

/*
 * Layer Tap Settings
 */
&lt {
    // Increase layer tap time
    tapping-term-ms = <300>;

    // Quickly tap-tap-holding the lt button will repeat the tap behavior
    // For example enter-enter-hold, will output multiple enter while you
    // keep holding the key.
    // But holding enter without double tapping, will activate the layer.
     quick_tap_ms = <200>;

     flavor = "balanced";
};


// Behavior configuration
//&mt {
//    tapping-term-ms = <200>;
//    quick_tap_ms = <0>;
//    flavor = "tap-preferred";
//};
//&lt {
//    tapping-term-ms = <200>;
//    quick_tap_ms = <0>;
//    flavor = "tap-preferred";
//};
//&sk {
//    release-after-ms = <500>;
//    quick-release;
//};
